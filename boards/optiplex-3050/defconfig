## boards/optiplex-3050/defconfig
```kconfig
CONFIG_VENDOR_DELL=y
CONFIG_BOARD_DELL_OPTIPLEX_3050=y
CONFIG_CBFS_SIZE=0xEEE000
CONFIG_HAVE_IFD_BIN=y
CONFIG_IFD_BIN_PATH="descriptor.bin"
CONFIG_DO_NOT_TOUCH_DESCRIPTOR_REGION=y
CONFIG_VALIDATE_INTEL_DESCRIPTOR=y
CONFIG_PAYLOAD_EDK2=y
CONFIG_TPM_MEASURED_BOOT=y
CONFIG_CONSOLE_SERIAL_RUNTIME=y
# CONFIG_CONSOLE_SERIAL is not set
CONFIG_NO_POST=y
CONFIG_POWER_STATE_PREVIOUS_AFTER_FAILURE=y
CONFIG_EDK2_BOOT_MANAGER_ESCAPE=y
# CONFIG_EDK2_HAVE_EFI_SHELL is not set
CONFIG_DRIVERS_EFI_FW_INFO=y
CONFIG_DRIVERS_EFI_MAIN_FW_GUID="d0174e30-d179-4b38-8087-acbe44083a7a"
CONFIG_DRIVERS_EFI_UPDATE_CAPSULES=y
CONFIG_DRIVERS_EFI_CAPSULE_ON_DISK_SUPPORT=y
CONFIG_BOOTMEDIA_SMM_BWP=y
CONFIG_BOOTMEDIA_SMM_BWP_RUNTIME_OPTION=y
CONFIG_EDK2_CUSTOM_BUILD_PARAMS="-D NETWORK_IPXE_DRIVER=TRUE"
CONFIG_USE_LEGACY_8254_TIMER=y
# CONFIG_SOC_INTEL_COMMON_BLOCK_SMM_TCO_INTRUDER_SMI_ENABLE is not set
```
